## app/boards/shields/mintyk/kconfig.shield
```kconfig
# Copyright (c) 2020 Pete Johanson
# SPDX-License-Identifier: MIT

config SHIELD_MINTYK_LEFT
    def_bool $(shields_list_contains,mintyk_left)

config SHIELD_MINTYK_RIGHT
    def_bool $(shields_list_contains,mintyk_right)
```
